// Unicode characters typed with the Linux Ctrl+Shift+U input method.
/ {
    macros {
        degr: degr {
            compatible = "zmk,behavior-macro";
            #binding-cells = <0>;
            wait-ms = <0>;
            tap-ms = <0>;
            bindings
                = <&macro_tap &kp LS(LC(U))>
                , <&macro_tap &kp KP_N0 &kp KP_N0 &kp B &kp KP_N0>
                , <&macro_tap &kp SPACE>
                ;
        };
    };
};
